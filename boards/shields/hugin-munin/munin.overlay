#include "hugin-munin.dtsi" // The shared dtsi file is included in the overlay

// Note: collumns are sorted by physical layout from left to right.
// Label of the kscan node in the dtsi
&kscan0 {
    col-gpios
        = <&pro_micro 10 GPIO_ACTIVE_HIGH>
        , <&pro_micro 16 GPIO_ACTIVE_HIGH>
        , <&pro_micro 14 GPIO_ACTIVE_HIGH>
        , <&pro_micro 15 GPIO_ACTIVE_HIGH>
        , <&pro_micro 18 GPIO_ACTIVE_HIGH>
        , <&pro_micro 19 GPIO_ACTIVE_HIGH>
        ;
};

&default_transform { // Offset of 6 because the left side has 6 columns
    col-offset = <6>;
};

&right_encoder {
    status = "okay";
};